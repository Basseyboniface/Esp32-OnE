## main/Kconfig.projbuild
```kconfig
menu "oneCam Configuration"

    menu "WiFi Credentials"
        config ONECAM_WIFI_SSID
            string "oneCam wifi ssid"
            default "oneCam-wiFi"
            help
                SSID (network name) for the application to connect to.
        
        config ONECAM_WIFI_PASSWORD
            string "oneCam wifi password"
            default "password"
            help
                WiFi password (WPA or WPA2) for the application to use.
    endmenu
            
    menu "Motion Detection"
        config ENABLE_MOTION_DETECTION
            bool "Enable oneCam motion detection"
            default "y"
            help
                When enabled, motion detection will be activated.

        config MOTION_DETECTION_PIN
            depends on ENABLE_MOTION_DETECTION
            int "oneCam motion detection button"
            default 12
            help
                GPIO pin number to be used as motion detection input.
    endmenu

    menu "Camera Flashlight"
        config ENABLE_FLASHLIGHT
            bool "Enable Camera Flashlight"
            default n
            help
                Enable Camera Flash or IR Illuminator

        config LEDC_PIN
            depends on ENABLE_FLASHLIGHT
            int "Camera Flash or IR Illuminator GPIO Pin"
            range 0 33
            default 4
            help
                Set a pin to illuminate the onboard LED or IR Illuminator when streaming or taking snapshots.
        
        config LED_MAX_INTENSITY
            depends on ENABLE_FLASHLIGHT
            int "LED Maximum Intensity (0-255)"
            range 0 255
            default 255
            help
                Limit the maximum intensity of the LED while streaming to prevent overheating (0-255).

        choice LEDC_SPEED_MODE
            depends on ENABLE_FLASHLIGHT
            bool "Select LEDC Timer Speed Mode"
            default LEDC_LOW_SPEED_MODE
            help 
                Select a speed mode for the LEDC channel 
        
            config LEDC_LOW_SPEED_MODE  
                bool "Low Speed mode"

            config LEDC_HIGH_SPEED_MODE
                bool "High speed mode"
        endchoice

        config LEDC_TIMER
            depends on ENABLE_FLASHLIGHT
            int "LEDC Timer"
            range 0 3
            default 1
            help
                Select the LEDC Timer (0-3)
            
        config LEDC_CHANNEL
            depends on ENABLE_FLASHLIGHT
            int "LEDC Channel"
            range 0 7
            default 1
            help
                Select the LEDC Channel (0-7)
    endmenu

endmenu
```

## sdkconfig.defaults
```kconfig
#
# SPIRAM configuration
#
CONFIG_SPIRAM=y
CONFIG_SPIRAM_TYPE_AUTO=y
#CONFIG_SPIRAM_TYPE_ESPPSRAM64=y
CONFIG_SPIRAM_IGNORE_NOTFOUND=y
CONFIG_SPIRAM_TRY_ALLOCATE_WIFI_LWIP=y

#
# RTCIO configuration
#
CONFIG_RTCIO_SUPPORT_RTC_GPIO_DESC=y

#
# LWIP
#
CONFIG_LWIP_LOCAL_HOSTNAME="oneCam"

#
# oneCan configurations
#
CONFIG_ENABLE_FLASHLIGHT=y
CONFIG_ENABLE_MOTION_DETECTION=y
CONFIG_MOTION_DETECTION_PIN=12

#
# HTTP Server
#
CONFIG_HTTPD_MAX_REQ_HDR_LEN=1024
```
